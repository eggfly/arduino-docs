/******************************************************************************

          版权所有 (C), 2011-2012, 信意电子科技(http://xydz123.taobao.com/)

 ******************************************************************************
  文 件 名   : main.c
  版 本 号   : v1.0
  作    者   : Guokaiyi
  生成日期   : 2012-12-1
  最近修改   : 
  功能描述   : OLED演示例程(51系列)
               说明: 
               ----------------------------------------------------------------
               G    电源地
               VCC  接5V或3.3v电源
               D0   P1^0（SCLK）
               D1   P1^1（MOSI）
               RST  P1^2
               DC   P1^3
               CS   已经默认选中，可以不接                   
               ----------------------------------------------------------------
  修改历史   :
  1.日    期   : 2012-12-1
    作    者   : Guokaiyi
    修改内容   : 创建文件

******************************************************************************/

/*----------------------------------------------------------------------------*
 * 包含头文件                                                                 *
 *----------------------------------------------------------------------------*/
#include "common.h"
#include "oled.h"

/*----------------------------------------------------------------------------*
 * 宏定义                                                                     *
 *----------------------------------------------------------------------------*/

/*----------------------------------------------------------------------------*
 * 全局变量                                                                   *
 *----------------------------------------------------------------------------*/

/*----------------------------------------------------------------------------*
 * 内部函数原型                                                               *
 *----------------------------------------------------------------------------*/
VOID MAIN_Init(VOID); //初始化函数
VOID MAIN_OLED_Display(VOID); //OLED显示函数
VOID MAIN_TIME_Delay(USHORT16 usTime); //延时函数

/*----------------------------------------------------------------------------*
 * 外部函数原型                                                               *
 *----------------------------------------------------------------------------*/

VOID main(void) 
{
    MAIN_Init();

    MAIN_OLED_Display();
    
    return;
}

VOID MAIN_Init(VOID)
{
    LED_Init();

    return;
}

VOID MAIN_OLED_Display(VOID)
{
    USHORT16 i;

    LED_P14x16Str(25, 0, (UCHAR8*)"信意电子科技");
    LED_P8x16Str(0, 2, (UCHAR8*)" http://xydz123.taobao.com");
    MAIN_TIME_Delay(4000);

    LED_Fill(0x00);    
    LED_P14x16Str(30, 1, (UCHAR8*)"屏幕测试");

    for (i = 0; i <= 100; i++)
    {
        MAIN_TIME_Delay(40);
        LED_PrintChar(45, 5, (CHAR8)i);        
    }

    LED_Fill(0xFF); //点亮全屏
    MAIN_TIME_Delay(8000);

    LED_Fill(0x00); //黑屏
    MAIN_TIME_Delay(2000);

    LED_P8x16Str(10, 2, (UCHAR8*)"Test Finished!");

    for (;;)
    {
        ;
    }
    
    return;
}

/*****************************************************************************
 函 数 名  : MAIN_TIME_Delay
 功能描述  : 在12MHz晶振 1T下 延时时间约等于usTime ms
 输入参数  : USHORT16 usTime  
 输出参数  : NONE
 返 回 值  : 
*****************************************************************************/
VOID MAIN_TIME_Delay(USHORT16 usTime)
{
    UCHAR8 j;
    LONG32 i;
    
    for (i = (LONG32)10 * usTime; i > 0; i--)
    {
        for(j = 110; j > 0; j--)
        {
        }
    }

    return;
}

